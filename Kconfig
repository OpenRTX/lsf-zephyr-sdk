## Kconfig
```kconfig
# Copyright (c) 2023 LISTENAI
# SPDX-License-Identifier: Apache-2.0

mainmenu "LSF Zephyr SDK"

module = LSF
module-str = lsf
source "subsys/logging/Kconfig.template.log_config"

rsource "Kconfig.dsp"
```

## Kconfig.dsp
```kconfig
# Copyright (c) 2023 LISTENAI
# SPDX-License-Identifier: Apache-2.0

menu "DSP Manipulation"

config LSF_DSP
	bool "DSP Manipulation"
	default y
	select FLASH
	select FLASH_MAP

if LSF_DSP

config LSF_DSP_INIT_PRIORITY
	int "Init priority"
	default 80

DT_CHOSEN_LSF_DSP_FIRMWARE := lsf,dsp-firmware

config LSF_DSP_LOAD_ON_BOOT
	bool "Load DSP firmware on boot"
	default y
	depends on $(dt_chosen_enabled,$(DT_CHOSEN_LSF_DSP_FIRMWARE))

endif # LSF_DSP

endmenu
```

## Kconfig.lsf
```kconfig
# Copyright (c) 2023 LISTENAI
# SPDX-License-Identifier: Apache-2.0

DT_COMPAT_LSF_SERVICE_CONTROLLER := lsf,service-controller

config LSF_SERVICE_CONTROLLER
	bool "LSF Service Controller"
	default $(dt_compat_enabled,$(DT_COMPAT_LSF_SERVICE_CONTROLLER))
	select REQUIRES_FULL_LIBC

if LSF_SERVICE_CONTROLLER
rsource "src/services/Kconfig"
endif # LSF_SERVICE_CONTROLLER
```

## dts/bindings/services/lsf,wasm-service.yaml
```yaml
# Copyright (c) 2023 LISTENAI
# SPDX-License-Identifier: Apache-2.0

description: LSF WASM Service

include: lsf-service.yaml

compatible: "lsf,wasm-service"

properties:
  wasm-app-partition:
    type: phandle
    description: |
      The phandle to the WASM app partition. If specified, the WASM app will be
      automatically loaded when the service is started.
    required: false
```

## samples/audio_duplex_48k/sample.yaml
```yaml
sample:
  name: audio_duplex_48k
tests:
  sample.audio_duplex_48k:
    tags: audio
```

## src/services/Kconfig
```kconfig
# Copyright (c) 2023 LISTENAI
# SPDX-License-Identifier: Apache-2.0

menu "LSF Services"

DT_COMPAT_LSF_AUDIO_SERVICE := lsf,audio-service

config LSF_AUDIO_SERVICE
	bool "LSF Audio Service"
	default $(dt_compat_enabled,$(DT_COMPAT_LSF_AUDIO_SERVICE))

DT_COMPAT_LSF_THINKER_SERVICE := lsf,thinker-service

config LSF_THINKER_SERVICE
	bool "LSF Thinker Service"
	default $(dt_compat_enabled,$(DT_COMPAT_LSF_THINKER_SERVICE))

endmenu
```

## tests/audio/recorder/testcase.yaml
```yaml
common:
  tags: audio recorder
tests:
  audio.recorder:
    integration_platforms:
      - csk6012_nano
```

## tests/audio/track/testcase.yaml
```yaml
common:
  tags: audio track
tests:
  audio.track:
    integration_platforms:
      - csk6012_nano
```

## tests/thinker/wasm/testcase.yaml
```yaml
common:
  tags: thinker wasm
tests:
  thinker.wasm:
    integration_platforms:
      - csk6012_nano
```

## west.yml
```yaml
# Copyright (c) 2023 LISTENAI
# SPDX-License-Identifier: Apache-2.0

manifest:
  remotes:
    - name: zephyr
      url-base: https://cloud.listenai.com/zephyr
    - name: listenai
      url-base: https://cloud.listenai.com/listenai

  projects:
    - name: zephyr
      remote: zephyr
      revision: 6d326a36d5a9cdabec97081914e558ee3b4738f6
      clone-depth: 1
      path: zephyr
      import:
        file: listenai/manifest.yml
        name-blocklist:
          - libmetal
          - sof
          - protobuf-c
          - esp-hosted
          - mcuboot
          - avf
          - licak
          - lisa_player
          - zport_sal
          - zport_esp
          - wifi_manager
          - xr819s
          - lvgl
          - csk_sqlite3
    - name: freertos_shims
      remote: listenai
      revision: v0.3.1
      path: modules/lib/freertos_shims
      repo-path: modules/freertos_shims
    - name: urpc
      remote: listenai
      revision: v0.2.0
      path: modules/lib/urpc
      repo-path: modules/urpc
    - name: lsf
      remote: listenai
      revision: v1.0.1
      path: modules/lib/lsf
      repo-path: modules/lsf
    - name: af
      remote: listenai
      revision: v1.0.4
      path: modules/lib/af
      repo-path: modules/af
```
